## boards/arm/semihalfino/Kconfig.defconfig
```kconfig
# Always set CONFIG_BOARD here. This isn't meant to be customized,
# but is set as a "default" due to Kconfig language restrictions.
config BOARD
    default "semihalfino"
    depends on BOARD_SEMIHALFINO

if BOARD_SEMIHALFINO

config RP2_FLASH_W25Q080
	default y

if I2C_DW

config I2C_DW_CLOCK_SPEED
	default 125

endif # I2C_DW

config USB_SELF_POWERED
	default n

endif # BOARD_SEMIHALFINO
```

## boards/arm/semihalfino/board.yml
```yaml
# SPDX-License-Identifier: MIT

board:
  name: semihalfino
  vendor: semihalf
  socs:
  - name: rp2040
```

## boards/arm/semihalfino/semihalfino_defconfig
```kconfig
CONFIG_SYS_CLOCK_HW_CYCLES_PER_SEC=125000000
CONFIG_SERIAL=y
CONFIG_CONSOLE=y
CONFIG_UART_CONSOLE=y
CONFIG_GPIO=y
CONFIG_USE_DT_CODE_PARTITION=y
CONFIG_BUILD_OUTPUT_UF2=y
CONFIG_BUILD_OUTPUT_HEX=y
CONFIG_UART_INTERRUPT_DRIVEN=y
CONFIG_RESET=y
CONFIG_CLOCK_CONTROL=y
CONFIG_SPI=y
CONFIG_DISPLAY=y
CONFIG_DISPLAY_LED_MULTIPLEX_MATRIX=y
CONFIG_GPIO_SN74HC595_BITBANG=y
```

## drivers/Kconfig
```kconfig
# SPDX-License-Identifier: MIT

menu "Drivers"
rsource "gpio/Kconfig"
rsource "display/Kconfig"
endmenu
```

## drivers/display/Kconfig.led_multiplex_matrix
```kconfig
# Copyright (c) 2024 Jakub Czapiga
# SPDX-License-Identifier: Apache-2.0

config DISPLAY_LED_MULTIPLEX_MATRIX
	bool "LED matrix driven by GPIOs"
	default y
	help
	  Enable driver for a LED matrix with rows and columns driven by
	  GPIOs. Assignment of GPIOs to rows and columns and the mapping
	  of those to pixels are specified in properties
	  of a "led-multiplex-matrix" compatible node in devicetree.
	  The driver uses one TIMER instance.
```
